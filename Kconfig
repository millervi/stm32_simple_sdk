## Kconfig
```kconfig
mainmenu "Project configuration"

source "configuration/settings_of_build/Kconfig"
source "configuration/general/Kconfig"
source "components/*/Kconfig"
```

## components/assert/Kconfig
```kconfig
menu "Component: assert"
    config ASSERT_ON
        bool "Enable assert"
        help
            This enables assert
endmenu
```

## components/logger/Kconfig
```kconfig
menu "Component: logger"
    config LOGGER_ON
        bool "Enable logger"
        help
            This enables logger
endmenu
```

## configuration/general/Kconfig
```kconfig
menu "General"
    config PROJECT_NAME
        string "Project name"
    help
        This name will be used in the main cmake file.

    config PROJECT_VERSION
        string "Project version"
    help
        This version will be used in the main cmake file, use format major.minor.path (for example 0.0.1).
endmenu
```

## configuration/settings_of_build/Kconfig
```kconfig
menu "Settings of build"
    config CXX_ON
        bool "Enable CXX"
        help
            This enables CXX.

    menu "MCU"
        source "configuration/settings_of_build/Kconfig_mcu.in"
    endmenu

    menu "GCC assembler"
        source "configuration/settings_of_build/Kconfig_gcc_assembler.in"
    endmenu

    menu "GCC compiler"
        source "configuration/settings_of_build/Kconfig_gcc_compiler.in"
    endmenu

    menu "GCC linker"
        # depends on !CXX_ON
        source "configuration/settings_of_build/Kconfig_gcc_linker.in"
    endmenu
    
    menu "G++ compiler"
        # depends on CXX_ON
        source "configuration/settings_of_build/Kconfig_g++_compiler.in"
    endmenu

    menu "G++ linker"
        # depends on CXX_ON
        source "configuration/settings_of_build/Kconfig_g++_linker.in"
    endmenu
endmenu
```
